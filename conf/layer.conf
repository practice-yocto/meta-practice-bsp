## conf/layer.conf
```bitbake
# We have a conf and classes directory, add to BBPATH
BBPATH .= ":${LAYERDIR}"

# We have recipes-* directories, add to BBFILES
BBFILES += "\
    ${LAYERDIR}/recipes-*/*.bb \
    ${LAYERDIR}/recipes-*/*/*.bb \
    ${LAYERDIR}/recipes-*/*.bbappend \
    ${LAYERDIR}/recipes-*/*/*.bbappend \
    "

BBFILE_COLLECTIONS += "practice-bsp"
BBFILE_PATTERN_practice-bsp = "^${LAYERDIR}/"
BBFILE_PRIORITY_practice-bsp = "6"

# LAYERDEPENDS_practice-bsp = "core"
# LAYERSERIES_COMPAT_practice-bsp = "kirkstone"
LAYERSERIES_COMPAT_practice-bsp = "${LAYERSERIES_COMPAT_core}"
```
